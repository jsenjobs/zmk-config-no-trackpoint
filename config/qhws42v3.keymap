/* source keypos definitions */
#include "../zmk-nodefree-config/keypos_def/keypos_42keys.h"

#define KEYS_L LT0 LT1 LT2 LT3 LT4 LM0 LM1 LM2 LM3 LM4 LB0 LB1 LB2 LB3 LB4
#define KEYS_R RT0 RT1 RT2 RT3 RT4 RM0 RM1 RM2 RM3 RM4 RB0 RB1 RB2 RB3 RB4
#define KEYS_T LH2 LH1 LH0 RH0 RH1 RH2

#define ZMK_MOUSE_DEFAULT_MOVE_VAL 1200
#define ZMK_MOUSE_DEFAULT_SCRL_VAL 20

/* Enable keymap features that require forks */
// #define HAS_UROB
#define HAS_MOUSE_KEYS
// #define HAS_MOUSE_TP
// #define HAS_CAPSLOCK

/* source the main keymap */
// #include "qh_base_v1.keymap"
#include "qh_base_v2.keymap"
// #include "base.keymap"
